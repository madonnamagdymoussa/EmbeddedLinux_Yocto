## meta-myserverlayer/conf/layer.conf
```bitbake
# We have a conf and classes directory, add to BBPATH
BBPATH .= ":${LAYERDIR}"

# We have recipes-* directories, add to BBFILES
BBFILES += "${LAYERDIR}/recipes-*/*/*.bb \
            ${LAYERDIR}/recipes-*/*/*.bbappend"

BBFILE_COLLECTIONS += "meta-myserverlayer"
BBFILE_PATTERN_meta-myserverlayer = "^${LAYERDIR}/"
BBFILE_PRIORITY_meta-myserverlayer = "6"

LAYERDEPENDS_meta-myserverlayer = "core"
LAYERSERIES_COMPAT_meta-myserverlayer = "kirkstone"
```
